/dts-v1/; /plugin/;

/ {
	fragment@0 {
		target-path = "/fabric-bus@40000000";
		#address-cells = <2>;
		#size-cells = <2>;

		__overlay__ {
			#address-cells = <2>;
			#size-cells = <2>;
			core-gpio-uio-0 {
				compatible = "generic-uio";
				reg = <0x0 0x40000100 0x0 0x0100>;
			};
		};
	};
};
