/dts-v1/; /plugin/;

/ {
	fragment@0 {
		target-path = "/fabric-bus@40000000";
		#address-cells = <2>;
		#size-cells = <2>;

		__overlay__ {
			#address-cells = <2>;
			#size-cells = <2>;
			clock_and_reset_0_fic_3_clk: clock_and_reset_0_fic_3_clk {
				compatible = "fixed-clock";
				#clock-cells = <0>;
				clock-frequency = <50000000>;
			};
			core_gpio_c1: coregpio@40000100 {
				compatible = "microchip,coregpio-rtl-v3";
				reg = <0x0 0x40000100 0x0 0x0100>;
				clocks = <&clock_and_reset_0_fic_3_clk>;
				status = "okay";
			};
		};
	};
};
