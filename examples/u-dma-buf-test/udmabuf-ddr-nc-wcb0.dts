/dts-v1/; /plugin/;

/ {
	fragment@0 {
		target-path = "/fabric-bus@40000000";
		#address-cells = <2>;
		#size-cells = <2>;

		__overlay__ {
			#address-cells = <2>;
			#size-cells = <2>;
			udmabuf-ddr-nc-wcb0 {
				compatible = "ikwzm,u-dma-buf";
				device-name = "udmabuf-ddr-nc-wcb0";
				memory-region = <&fabricbuf2ddrncwcb>;
				size = <0x2000000>;
			};
		};
	};
};
