/dts-v1/; /plugin/;

/ {
	fragment@0 {
		target-path = "/fabric-bus@40000000";
		#address-cells = <2>;
		#size-cells = <2>;

		__overlay__ {
			#address-cells = <2>;
			#size-cells = <2>;
			fpgadma: dma-controller@60010000 {
				compatible = "microchip,mpfs-fpga-dma";
				reg = <0x0 0x60010000 0x0 0x1000>;
				interrupt-parent = <&plic>;
				interrupts = <120>;
				#dma-cells = <1>;
			};
			udmabuf-ddr-c0 {
				compatible = "ikwzm,u-dma-buf";
				device-name = "udmabuf-ddr-c0";
				memory-region = <&fabricbuf0ddrc>;
				size = <0x1000000>;
			};
			udmabuf-ddr-c1 {
				compatible = "ikwzm,u-dma-buf";
				device-name = "udmabuf-ddr-c1";
				memory-region = <&fabricbuf0ddrc>;
				size = <0x1000000>;
			};
		};
	};
};
